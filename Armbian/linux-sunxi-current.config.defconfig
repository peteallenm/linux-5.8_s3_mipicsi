## Armbian/openhd_x20dev_defconfig
```kconfig
CONFIG_ARM=y
CONFIG_ARCH_SUNXI=y
CONFIG_DEFAULT_DEVICE_TREE="sun8i-s3-openhd-x20dev"
CONFIG_SPL=y
CONFIG_MACH_SUN8I_V3S=y
CONFIG_SUNXI_DRAM_DDR3_1333=y
CONFIG_DRAM_CLK=504
CONFIG_DRAM_ODT_EN=y
CONFIG_I2C0_ENABLE=y
# CONFIG_HAS_ARMV7_SECURE_BASE is not set
CONFIG_SPL_I2C=y
CONFIG_SPL_SYS_I2C_LEGACY=y
CONFIG_SYS_I2C_MVTWSI=y
CONFIG_SYS_I2C_SLAVE=0x7f
CONFIG_SYS_I2C_SPEED=100000
# CONFIG_NETDEVICES is not set
CONFIG_CONS_INDEX=1
CONFIG_SPI=y
```

## linux-5.8/drivers/staging/media/sunxi/sun6i-csi-ao/Kconfig
```kconfig
# SPDX-License-Identifier: GPL-2.0-only
config VIDEO_SUN6I_MIPI_CSI_AO
	tristate "Allwinner A31 Camera Sensor Interface (CSI) Driver by Aodzip"
	depends on V4L_PLATFORM_DRIVERS && VIDEO_DEV && HAS_DMA
	depends on ARCH_SUNXI || COMPILE_TEST
	depends on PM && COMMON_CLK && RESET_CONTROLLER && HAS_DMA
	select MEDIA_CONTROLLER
	select VIDEO_V4L2_SUBDEV_API
	select VIDEOBUF2_DMA_CONTIG
	select V4L2_FWNODE
	select REGMAP_MMIO
	help
	   Support for the Allwinner A31 Camera Sensor Interface (CSI) (Aodzip version)
	   controller, also found on other platforms such as the 
	   V3/V3s or A64.
```
